## bme280/main/Kconfig.projbuild
```kconfig
menu "Example Configuration"

    orsource "$IDF_PATH/examples/common_components/env_caps/$IDF_TARGET/Kconfig.env_caps"

    config EXAMPLE_URL
        string "URL to use for GET"
        default "http://192.168.5.2:8080/tmp.txt"
        help
            An URL to use for GET.

endmenu
```
